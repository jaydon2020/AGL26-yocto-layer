## bsp/meta-agl-refhw/meta-agl-refhw-gen3/conf/layer.conf
```bitbake
# We have a conf and classes directory, add to BBPATH
BBPATH .= ":${LAYERDIR}"

# We have recipes-* directories, add to BBFILES
BBFILES += " \
	${LAYERDIR}/recipes-*/*/*.bb \
	${LAYERDIR}/recipes-*/*/*.bbappend \
	${LAYERDIR}/recipes-*/*.bb \
	${LAYERDIR}/recipes-*/*.bbappend \
"

BBFILE_COLLECTIONS += "agl-refhw-gen3"
BBFILE_PATTERN_agl-refhw-gen3 = "^${LAYERDIR}"
BBFILE_PRIORITY_agl-refhw-gen3  = "11"

LAYERDEPENDS_agl-refhw-gen3 = "core rcar-gen3"

LAYERSERIES_COMPAT_agl-refhw-gen3  = "scarthgap"

LICENSE_PATH += "${LAYERDIR}/licenses"
```

## bsp/meta-agl-refhw/meta-agl-refhw-gen3/conf/machine/agl-refhw-h3.conf
```bitbake
# Using H3, needs to be defined before pulling in salvator-x as a base
SOC_FAMILY = "r8a7795"

require conf/machine/salvator-x.conf

# This is a bit of a hack, we add salvator-x to avoid having to
# bbappend various recipes to update COMPATIBLE_MACHINE.  Ideally,
# we would want the ordering salvator-x:<machine>, but that is
# non-trivial to accomplish and not absolutely necessary for our
# expected use.
MACHINEOVERRIDES:append = ":salvator-x"

# Reference hardware has USB3
MACHINE_FEATURES:append = " usb3"

KERNEL_DEVICETREE:append = " renesas/r8a77951-agl-refhw.dtb"
```

## bsp/meta-rcar/meta-rcar-gen3-adas/conf/layer.conf
```bitbake
# We have a conf and classes directory, append to BBPATH
BBPATH .= ":${LAYERDIR}"

# We have a recipes directory, add to BBFILES
BBFILES += " \
    ${LAYERDIR}/recipes-*/*/*.bb \
    ${LAYERDIR}/recipes-*/*/*.bbappend \
"

BBFILE_COLLECTIONS += "rcar-gen3-adas"
BBFILE_PATTERN_rcar-gen3-adas := "^${LAYERDIR}/"
BBFILE_PRIORITY_rcar-gen3-adas = "7"

LAYERSERIES_COMPAT_rcar-gen3-adas = "scarthgap"

# Distro features needed for all boards
DISTRO_FEATURES:remove = "x11"
DISTRO_FEATURES:append:rcar-gen3-v3x = " surroundview opencv-sdk"

# Distro features needed for non V3x only (default)
VAR_FEATURES = "bluetooth pulseaudio"
# Distro features needed for V3x only
VAR_FEATURES:rcar-gen3-v3x = ""
DISTRO_FEATURES:append = " ${VAR_FEATURES}"

# Is it still needed with x11 feature removed?
IMAGE_INSTALL:remove = " gtk+3-demo clutter-1.0-examples libx11-locale"

# ADAS BSP packages
DISTRO_FEATURES:append = " bsp-pkgs"

# For e2studio
EXTRA_IMAGE_FEATURES:append = " eclipse-debug"
# Extra image features rquested by Renesas
EXTRA_IMAGE_FEATURES:append = " \
    dev-pkgs \
    tools-sdk \
    tools-profile \
    tools-debug \
    package-management \
    ssh-server-openssh \
"

hostname:pn-base-files:rcar-gen3-v3x = "v3x"
```

## bsp/meta-rockchip-extra/conf/layer.conf
```bitbake
# Copyright (c) 2023, Automotive Grade Linux
# Released under the MIT license (see COPYING.MIT for the terms)

# We have a conf and classes directory, add to BBPATH
BBPATH .= ":${LAYERDIR}"

# We have recipes-* directories, add to BBFILES
BBFILES += "${LAYERDIR}/recipes-*/*/*.bb \
	    ${LAYERDIR}/recipes-*/*/*.bbappend"

BBFILE_COLLECTIONS += "rockchip-extra"
BBFILE_PATTERN_rockchip-extra := "^${LAYERDIR}/"
BBFILE_PRIORITY_rockchip-extra = "10"

BBFILES_DYNAMIC += " \
    qt6-layer:${LAYERDIR}/dynamic-layers/meta-qt6/*/*/*.bb \
    qt6-layer:${LAYERDIR}/dynamic-layers/meta-qt6/*/*/*.bbappend \
"

LAYERDEPENDS_rockchip-extra = "rockchip"

# This should only be incremented on significant changes that will
# cause compatibility issues with other layers
LAYERVERSION_rockchip-extra = "1"
LAYERSERIES_COMPAT_rockchip-extra = "kirkstone scarthgap"
```

## bsp/meta-rockchip-extra/conf/machine/rockchip-rk3588-nanopc-t6.conf
```bitbake
#@TYPE: Machine
#@NAME: RK3588 friendlyelec NanoPC-T6 and NanoPC-T6-LTS board

require conf/machine/include/rk3588.inc

MACHINEOVERRIDES .= ":nanopct6"

PREFERRED_VERSION_linux-rockchip := "6.1%"
LINUXLIBCVERSION := "6.1-custom%"
OLDEST_KERNEL := "6.1"

KBUILD_DEFCONFIG = "nanopi6_linux_defconfig"
KERNEL_DEVICETREE = "rockchip/rk3588-nanopi6-rev07.dtb"

UBOOT_MACHINE = "nanopi6_defconfig"

EXTRA_IMAGEDEPENDS:append = " u-boot-rockchip"
WKS_FILES ?= "rockchip-gptdisk.wks"

RK_WIFIBT_FIRMWARES = " \
    linux-firmware-rtl8822 \
"

MACHINE_EXTRA_RRECOMMENDS:append = " \
    linux-firmware-rtl8125 \
    ${RK_WIFIBT_FIRMWARES} \
"
```

## bsp/meta-rockchip-extra/wic/rockchip-gptdisk.wks
```
# Copyright (c) 2019, Fuzhou Rockchip Electronics Co., Ltd
# Released under the MIT license (see COPYING.MIT for the terms)
#
# long-description: Creates a GPT disk image for Rockchip boards

# 0~32K: gpt
bootloader --ptable gpt
part --source rawcopy --sourceparams="file=idblock.img" --align 32 --no-table
part --source rawcopy --sourceparams="file=uboot.img" --part-name uboot --align 8192
part --source rawcopy --sourceparams="file=boot.img" --part-name boot
part / --source rootfs --fstype ext4 --part-name rootfs --uuid 614e0000-0000-4b53-8000-1d28000054a9 --align 8192
```
